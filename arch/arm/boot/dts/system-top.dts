/*
 * CAUTION: This file is automatically generated by Xilinx.
 * Version: XSCT 2023.1
 * Today is: Sun May 26 17:13:32 2024
 */


/dts-v1/;
#include "zynq-7000.dtsi"
#include "pl.dtsi"
#include "pcw.dtsi"
/ {
	chosen {
		bootargs = "earlycon";
		stdout-path = "serial0:115200n8";
	};
	aliases {
		ethernet0 = &gem0;
		serial0 = &uart1;
		spi0 = &qspi;
		spi1 = &spi0;
	};
	memory@0 {
		device_type = "memory";
		reg = <0x0 0x20000000>;
	};
};

#include "system-user.dtsi"
